/*
 * PushButton.asm
 *
 *  Created: 2/12/2020 11:24:21 AM
 *   Author: argk4
 */ 

	LDI R16, 0XFF
	LDI R17, 0

	OUT DDRD, R16
	OUT PORTD, R16

	OUT DDRA, R17
	OUT PORTA, R16

MAIN:
	CHECK_SW1:
		SBIC PINA, 0
		RJMP CHECK_SW3
		CBI PORTD, 0
		CALL QDELAY
	LED1_OFF:
		SBI PORTD, 0
	CHECK_SW3:
		SBIC PINA, 2
		RJMP CHECK_SW7
		CBI PORTD, 2
		CALL QDELAY
	LED3_OFF:
		SBI PORTD, 2
	CHECK_SW7:
		SBIC PINA, 5
		RJMP CHECK_SW9
		CBI PORTD, 5
		CALL QDELAY
	LED7_OFF:
		SBI PORTD, 5
	CHECK_SW9:
		SBIC PINA, 7
		RJMP CHECK_SW1
		CBI PORTD, 7
		CALL QDELAY
	LED9_OFF:
		SBI PORTD, 7


QDELAY:
		LDI R21, 255
		L2:
			LDI R20, 255
			L3:
				LDI R18, 25
				L4:
					NOP
					NOP
					DEC R18
					BRNE L4
				DEC R20
				BRNE L3
			DEC R21
			BRNE L2
			RET